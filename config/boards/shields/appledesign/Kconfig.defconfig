## config/boards/shields/appledesign/Kconfig.defconfig
```kconfig
if SHIELD_APPLEDESIGN

config ZMK_KEYBOARD_NAME
    default "AppleDesign"

config I2C
    default y

config GPIO
    default y

endif
```

## dts/bindings/gpio/microchip,mcp23017.yaml
```yaml
description: Microchip MCP23017 16-bit I2C GPIO expander

compatible: "microchip,mcp23017"

include: [gpio-controller.yaml, i2c-device.yaml]

properties:
  ngpios:
    type: int
    required: true
    description: Number of GPIOs (16 for MCP23017)

gpio-cells:
  - pin
  - flags
```
